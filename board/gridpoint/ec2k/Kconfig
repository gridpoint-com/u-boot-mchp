## board/gridpoint/ec2k/Kconfig
```kconfig
if TARGET_GRIDPOINT_EC2K

config SYS_BOARD
	default "ec2k"

config SYS_VENDOR
	default "gridpoint"

config SYS_SOC
	default "at91"

config SYS_CONFIG_NAME
	default "gridpoint-ec2k"

endif
```

## board/gridpoint/edge/Kconfig
```kconfig
if TARGET_GRIDPOINT_EDGE

config SYS_BOARD
	default "edge"

config SYS_VENDOR
	default "gridpoint"

config SYS_SOC
	default "at91"

config SYS_CONFIG_NAME
	default "gridpoint-edge"

endif
```
